#include "board.h"
#include <SPI.h>
#include <LoRa.h>
#include "SSD1306Wire.h" 
SSD1306Wire display(OLED_ADDRESS, OLED_SDA, OLED_SCL);


//////////////////////////////////////////////////////// CONFIG /////////////////////////////////////////////////////////////////

#define SignalBandwidth 125E3
#define SpreadingFactor 12
#define CodingRate 8
#define SyncWord 0xF3
#define PreambleLength 8
#define TxPower 20
float BAND = 868E6;  // 868E6 / 915E6 / 433E6

String NewMailCode = "0xAAAA";
String LowBatteryCode = "0xFFFF";

/////////////////////////////////////////////////////////////////////////////////////////////////////////////////////////////////

String recv;
int count = 0;
int ledState = LOW;  // ledState used to set the LED
int NewMailDetected = 0;
const long interval = 1000;  // interval at which to blink (milliseconds)
unsigned long previousMillis = 0;  // will store last time LED was updated



#define Bitmap_mail_logo_width 62
#define Bitmap_mail_logo_height 40
const unsigned char Bitmap_mail_logo [] PROGMEM = {
  0xf8, 0xff, 0xff, 0xff, 0xff, 0xff, 0xff, 0x07, 0xfc, 0xff, 0xff, 0xff, 0xff, 0xff, 0xff, 0x0f, 
  0xfe, 0xff, 0xff, 0xff, 0xff, 0xff, 0xff, 0x1f, 0xff, 0x00, 0x00, 0x00, 0x00, 0x00, 0xc0, 0x3f, 
  0xf7, 0x01, 0x00, 0x00, 0x00, 0x00, 0xe0, 0x3b, 0xe7, 0x03, 0x00, 0x00, 0x00, 0x00, 0xf0, 0x39, 
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  0xfc, 0xff, 0xff, 0xff, 0xff, 0xff, 0xff, 0x1f, 0xf8, 0xff, 0xff, 0xff, 0xff, 0xff, 0xff, 0x07
};



#define Bitmap_battery_full_width 27
#define Bitmap_battery_full_height 15
const unsigned char Bitmap_battery_full [] PROGMEM = {


  0xff, 0xff, 0xff, 0x00, 0xff, 0xff, 0xff, 0x00, 0x03, 0x00, 0x80, 0x00, 0x33, 0xe6, 0x9c, 0x03, 
  0x7b, 0xe7, 0x9c, 0x07, 0x7b, 0xe7, 0x9c, 0x07, 0x7b, 0xe7, 0x9c, 0x07, 0x7b, 0xe7, 0x9c, 0x07, 
  0x7b, 0xe7, 0x9c, 0x07, 0x7b, 0xe7, 0x9c, 0x07, 0x7b, 0xe7, 0x9c, 0x07, 0x33, 0xe6, 0x9c, 0x03, 
  0x03, 0x00, 0x80, 0x00, 0xff, 0xff, 0xff, 0x00, 0xff, 0xff, 0xff, 0x00
  
};




#define Bitmap_battery_empty_width 27
#define Bitmap_battery_empty_height 15
const unsigned char Bitmap_battery_empty [] PROGMEM = {


  0xfe, 0xff, 0xff, 0x00, 0xff, 0xff, 0xff, 0x00, 0x03, 0x00, 0x80, 0x00, 0x03, 0x00, 0x80, 0x01, 
  0x13, 0x00, 0x80, 0x07, 0x13, 0x00, 0x80, 0x07, 0x13, 0x00, 0x80, 0x07, 0x13, 0x00, 0x80, 0x07, 
  0x13, 0x00, 0x80, 0x07, 0x13, 0x00, 0x80, 0x07, 0x13, 0x00, 0x80, 0x07, 0x13, 0x00, 0x80, 0x03, 
  0x03, 0x00, 0x80, 0x00, 0xff, 0xff, 0xff, 0x00, 0xfe, 0xff, 0xff, 0x00
  
};




void setup() {
  Serial.begin(9600);
  while (!Serial);

  
  if (OLED_RST > 0) {
      pinMode(OLED_RST, OUTPUT);
      digitalWrite(OLED_RST, HIGH);
      delay(100);
      digitalWrite(OLED_RST, LOW);
      delay(100);
      digitalWrite(OLED_RST, HIGH);
  }
  display.init();
  
  pinMode(LED_PIN, OUTPUT);
  digitalWrite(LED_PIN, LOW);


      display.flipScreenVertically();
      display.setFont(ArialMT_Plain_10);
      display.setTextAlignment(TEXT_ALIGN_CENTER);
      display.drawString(64, 5, "PricelessToolkit");
      display.setFont(ArialMT_Plain_16);
      display.setTextAlignment(TEXT_ALIGN_CENTER);
      display.drawString(64, 20, "MailBox Guard");
      display.drawString(64, 38, "RX " + String(BAND));
      display.display();
      delay(2000);
      display.clear();
      display.display();
      

  




  SPI.begin(CONFIG_CLK, CONFIG_MISO, CONFIG_MOSI, CONFIG_NSS);
  LoRa.setPins(CONFIG_NSS, CONFIG_RST, CONFIG_DIO0);
  Serial.println("Starting LoRa on " + String(BAND)+ " MHz");
  if (!LoRa.begin(BAND)) {
      Serial.println("Starting LoRa failed!");
      while (1);
  }
  
  LoRa.setSignalBandwidth(SignalBandwidth);         // signal bandwidth in Hz, defaults to 125E3
  LoRa.setSpreadingFactor(SpreadingFactor);                 // ranges from 6-12,default 7 see API docs
  LoRa.setCodingRate4(CodingRate);        // Supported values are between 5 and 8, these correspond to coding rates of 4/5 and 4/8. The coding rate numerator is fixed at 4.
  LoRa.setSyncWord(SyncWord);                     // byte value to use as the sync word, defaults to 0x12
  LoRa.setPreambleLength(PreambleLength);       //Supported values are between 6 and 65535.
  LoRa.disableCrc();                          // Enable or disable CRC usage, by default a CRC is not used LoRa.disableCrc();
  LoRa.setTxPower(TxPower);                // TX power in dB, defaults to 17, Supported values are 2 to 20
  
}




void NewMailLed()
{

   if (NewMailDetected == 1){
      unsigned long currentMillis = millis();
      if (currentMillis - previousMillis >= interval) {
        // save the last time you blinked the LED
        previousMillis = currentMillis;

        // if the LED is off turn it on and vice-versa:
        if (ledState == LOW) {
          ledState = HIGH;
      } else {
          ledState = LOW;
        }

        // set the LED with the ledState of the variable:
        digitalWrite(LED_PIN, ledState);
    }
  } 
}



void loop(){
  
    NewMailLed();
    
    if (LoRa.parsePacket()) {
        String recv = "";
        while (LoRa.available()) {
            recv += (char)LoRa.read();
        }
        
        count++;
        Serial.println(recv);

        if (recv == NewMailCode){
            NewMailDetected = 1;
            display.clear();
            display.drawXbm(63, 3, Bitmap_mail_logo_width, Bitmap_mail_logo_height, Bitmap_mail_logo);
            display.drawXbm(97, 48, Bitmap_battery_full_width, Bitmap_battery_full_height, Bitmap_battery_full);
            display.setTextAlignment(TEXT_ALIGN_LEFT);
            display.setFont(ArialMT_Plain_16);
            display.drawString(3, 3, "NEW");
            display.drawString(18, 20, "MAIL");
            int NewMailCount = count / 2;
            display.drawString(89, 6, String(NewMailCount));
            //display.setTextAlignment(TEXT_ALIGN_LEFT);
            display.setFont(ArialMT_Plain_16);
            String rss = "RSSI: " + String(LoRa.packetRssi());
            display.drawString(5, 47, String(rss));
            display.display();
            
         }
        
         if (recv == LowBatteryCode){
              display.clear();
              NewMailDetected = 1;
              display.drawXbm(63, 3, Bitmap_mail_logo_width, Bitmap_mail_logo_height, Bitmap_mail_logo);
              display.drawXbm(97, 48, Bitmap_battery_full_width, Bitmap_battery_full_height, Bitmap_battery_empty);
              display.setTextAlignment(TEXT_ALIGN_LEFT);
              display.setFont(ArialMT_Plain_16);
              display.drawString(3, 3, "NEW");
              display.drawString(18, 20, "MAIL");
              int NewMailCount = count / 2;
              display.drawString(89, 6, String(NewMailCount));
              //display.setTextAlignment(TEXT_ALIGN_LEFT);
              display.setFont(ArialMT_Plain_16);
              String rss = "RSSI: " + String(LoRa.packetRssi());
              display.drawString(5, 47, String(rss));
              display.display();
         }
  

  }

}
